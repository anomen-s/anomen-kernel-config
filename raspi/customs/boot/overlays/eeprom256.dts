/dts-v1/;
/plugin/;

/ {
    compatible = "brcm,bcm2708";

    fragment@0 {
	target = <&i2c1>;

        __overlay__ {
            #address-cells     = <1>;
            #size-cells     = <0>;

            eeprom256: at24@50 {
                compatible = "at,24c256";
                reg = <0x50>;
                status = "okay";
            };
        };
    };


};

