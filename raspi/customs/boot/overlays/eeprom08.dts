/dts-v1/;
/plugin/;

/ {
    compatible = "brcm,bcm2708";

    fragment@0 {
	target = <&i2c1>;

        __overlay__ {
            #address-cells     = <1>;
            #size-cells     = <0>;
            status = "okay";


            eeprom08: at24@54 {
                compatible = "at,24c08";
                reg = <0x54>;
                status = "disable";
            };

        };
    };
/*
	__overrides__ {
			eeprom08 = <&eeprom08>,"status";
	};
*/
};

